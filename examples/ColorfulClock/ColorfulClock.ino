#include <avr/pgmspace.h>
#include "arduino.h"
#include <WS2812.h>
#include <Wire.h>
#include <avr/io.h>
#include <avr/interrupt.h>
#include <Wire.h>
#include "DS1307.h"
#include <Ultrasonic.h>

#define FONT_X 6
#define FONT_Y 8

const unsigned char simpleFont[][8] PROGMEM=
{
  {0x00,0x00,0x00,0x00,0x00,0x00,0x00,0x00},
  {0x00,0x00,0x5F,0x00,0x00,0x00,0x00,0x00},
  {0x00,0x00,0x07,0x00,0x07,0x00,0x00,0x00},
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  {0x00,0x02,0x05,0x05,0x02,0x00,0x00,0x00} 
};

enum UserCMD{
    CMD_UP = 0x0,
    CMD_DOWN = 0x1,
    CMD_LEFT = 0x2,
    CMD_RIGHT = 0x3,
    CMD_CENTOR = 0x4
};

DS1307 clock;//define a object of DS1307 class
WS2812 LED(256); //LED number
Ultrasonic ultrasonic(7);
volatile unsigned int count = 0;
bool beNear;
int ledBrightless;
int timeCount; 
int32_t currentColor;
uint8_t currentHour;
long startTime;

void setup()
{
    Serial.begin(9600);
    ledBrightless = 255;
    count = 0;
    startTime = millis();
    beNear = false;
    LED.init(5); //Digital Pin 5
    LED.setBrightness(ledBrightless);
    clockInit();
    freshTime();
}

void loop()
{
    updateLEDBrightless();
    //updateDistanse();
#if 0
    int cmd = getUserCMD();
    switch(cmd){
        case (CMD_UP):
          break;
        case(CMD_DOWN):
          break;
        case (CMD_LEFT):
          break;
        case (CMD_RIGHT):
          break;
        default:
          break;
    }
#endif    
    if(timeCount++ > 30){
        freshTime();
        timeCount = 0;
    }
    delay(1000);
}

int getDistanse()
{
    ultrasonic.MeasureInCentimeters();
    return ultrasonic.RangeInCentimeters; 
}

void updateDistanse()
{
    int distanse = getDistanse();
    Serial.println(distanse);
    if(distanse <= 100){
        if(beNear == false){
            //startTime = millis();
            scrollString("hello", 5, 100, LED.RGB(0,255,0));
            freshTime();
            beNear = true;    
        }
#if 0
        if(millis() - startTime > 2700000){ //45min
            LED.clear();
            LED.sync();
            drawString("relax", 5, 0, LED.RGB(255,0,0));
        }
#endif
    }else if((distanse >= 200) && (distanse <= 400)){
        if(beNear == true){
            
            scrollString("bye", 3, 100, LED.RGB(255,0,0));
            freshTime();
            beNear = false;
        }
    }
}

int getUserCMD()
{
    int val1 = analogRead(A1);
    int val2 = analogRead(A2);
    if(val1 < 100){
        return CMD_LEFT;
    }else if(val1 > 500){
        return CMD_RIGHT;
    }else if(val2 < 100){
        return CMD_DOWN;
    }else if(val2 > 500){
        return CMD_UP;
    }else{
        return CMD_CENTOR;
    }
}

void updateLEDBrightless()
{
    int temp = analogRead(A0);
    ledBrightless = abs(temp)/4;
    LED.setBrightness(ledBrightless);
}


void clockInit()
{
    clock.begin();
    clock.fillByYMD(2014,10,15);//Jan 19,2013
    clock.fillByHMS(9,48,30);//15:28 30"
    clock.fillDayOfWeek(WED);//Saturday
    clock.setTime();//write time to the RTC chip
}
void freshTime()
{
    clock.getTime();
    LED.clear();
    LED.sync();
    showHourMessage();
    uint8_t color = clock.hour;
    String hour = String(clock.hour);
    String minute = String(clock.minute);
    String time;
    if(clock.hour < 10){
        if(clock.minute < 10){
          time = '0' + hour + ':' + '0' + minute;
        }else{
          time = '0' + hour + ':' + minute;
        }
    }else{
        if(clock.minute < 10){
          time = hour + ':' + '0' + minute;
        }else{
          time = hour + ':' + minute;
        }
    }
    char timeArray[6];
    time.toCharArray(timeArray,6);
    if((color >=8) && (color<=20)){ //08:00~20:00
        currentColor = LED.RGB(20*color-160, 400-20*color, 0);
        drawStringWithDelay(timeArray,5,0,currentColor,200);
    }else{
      
    }   
}

void showHourMessage()
{
    if(currentHour != clock.hour){
        currentHour = clock.hour;
        String hour = String(currentHour);
        String message = "It's "+ hour + " o'clock "; 
        char messageArray[16];
        message.toCharArray(messageArray,16);
        scrollString(messageArray, 16, 100, LED.RGB(255,0,0));
        //LED.rainbow(20);
        //LED.theaterChase(LED.RGB(  0, 255,   0), 50); // green
        //LED.theaterChase(LED.RGB(255,   0,   0), 50); // Red
        //LED.theaterChase(LED.RGB(  0,   0, 255), 50); // Blue
        LED.clear();
        LED.sync();
    }
}

void scrollString(char* str, uint8_t len, uint8_t wait, uint32_t color)
{
    updateLEDBrightless();
    for(int p = len*3; p >= -len*3; p--){
        LED.clear();
        for(int i = 0; i < len; i++){
            drawChar(str[i], i*3 + p, color);
        }
        LED.sync();
        delay(wait);
    }
}

void drawString(char* str, uint8_t len, uint8_t posit, uint32_t color)
{
    updateLEDBrightless();
    for(int i = 0; i < len; i++){
        drawChar(str[i], i*3+posit*3, color);
        LED.sync();  
    }
}

void drawStringWithDelay(char* str, uint8_t len, uint8_t posit, uint32_t color, uint8_t wait)
{
    for(int i = 0; i < len; i++){
        drawChar(str[i], i*3+posit*3, color);
        LED.sync();  
        delay(wait);
    }
}

void drawChar(uint8_t ascii, int8_t posit, uint32_t color)
{
    if((ascii<32)||(ascii>=127)){
        return;
    }

    for (int8_t i = 0; i < FONT_X; i++ ) {
        int8_t temp = pgm_read_byte(&simpleFont[ascii-0x20][i]);
        for(int8_t f = 0; f < FONT_Y; f++){
            if((temp>>f)&0x01){
                uint16_t index = changeAxisToPoint(i,f);
                index += posit*16;
                if((index < 256) && (index >= 0)){
                    LED.setRGB(index, color);
                }
            }
        }
    }
}

uint16_t changeAxisToPoint(uint8_t po_x, uint8_t po_y)
{
    uint16_t point = 0;
    point = ((po_x%2==0)?(8*po_x+po_y):(8*po_x+7-po_y));
    return point;
}

